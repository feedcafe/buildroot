## package/adbd/Config.in
```kconfig
config BR2_PACKAGE_ADBD
	bool "adb daemon"
	help
	  adb daemon is android debug bridge for developers, adb 
	  daemon also implements user space driver through functionfs

	  https://github.com/feedcafe/adbd
```

## package/hidd/Config.in
```kconfig
config BR2_PACKAGE_HIDD
	bool "hid daemon"
	help
	  hid daemon are used to pass hid reports received
	  from bluetooth hid device to hidg usb gadget

	  ftp://192.168.1.101/hidd
```
